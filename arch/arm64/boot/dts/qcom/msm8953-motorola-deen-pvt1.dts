// SPDX-License-Identifier: (GPL-2.0+ OR BSD-3-Clause)
/*
 * Motorola One Deen PVT1 board candidate.
 * PVT1 hardware identity checked against the supplied stock boot_b FDT and
 * fastboot getvar hwrev. The remaining minimal DTS is not yet stock-equivalent.
 */

/dts-v1/;

#include "msm8953-motorola-deen-common.dtsi"

/ {
	model = "deen";
	compatible = "motorola,deen", "qcom,msm8953";
	qcom,msm-id = <0x125 0>;
	qcom,board-id = <0x4D 0xC100>;
};
