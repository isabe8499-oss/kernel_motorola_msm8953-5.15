// SPDX-License-Identifier: (GPL-2.0+ OR BSD-3-Clause)
/*
 * Motorola One Deen PVT2 board candidate.
 * PVT2 is retained only as a comparison candidate; it is not the user's
 * reported hardware revision and has not been approved.
 */

/dts-v1/;

#include "msm8953-motorola-deen-common.dtsi"

/ {
	model = "deen";
	compatible = "qcom,msm8953-deen", "qcom,msm8953-moto", "qcom,msm8953";
	qcom,board-id = <0x4D 0xC200>;
};
